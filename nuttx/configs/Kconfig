## nuttx/configs/Kconfig
```kconfig
#
# For a description of the syntax of this configuration file,
# see misc/tools/kconfig-language.txt.
#

choice
	prompt "Select target board"
	default ARCH_BOARD_CUSTOM
	---help---
		Select the board hosting the architure.  You must first select the
		exact MCU part number, then the boards supporting that part will
		be available for selection.  Use ARCH_BOARD_CUSTOM to create a new
		board configuration.

config ARCH_BOARD_NUTINY_NUC120
	bool "Nuvoton NuTiny NUC120"
	depends on ARCH_CHIP_NUC120LE3AN
	select ARCH_HAVE_LEDS
	---help---
		This is the port to the Nuvoton NuTiny EVB 120 board.  This board uses a 
		Nuvoton NUC120 chip, specifically the NUC120LE3AN.  See http://www.nuvoton.com/
		for further information.

config ARCH_BOARD_STM32_TINY
	bool "STM32-Tiny board"
	depends on ARCH_CHIP_STM32F103C8
	select ARCH_HAVE_LEDS
	---help---
		A configuration for the STM32 Tiny board. This board is based on a
		STM32F103C8T6 micro-controller chip, and is (always ?) bundled with
		an nRF24L01+ wireless module.

config ARCH_BOARD_STM3210E_EVAL
	bool "STMicro STM3210E-EVAL development board"
	depends on ARCH_CHIP_STM32F103ZET6
	select ARCH_HAVE_LEDS
	select ARCH_HAVE_BUTTONS
	select ARCH_HAVE_IRQBUTTONS
	---help---
		STMicro STM3210E-EVAL development board based on the STMicro STM32F103ZET6
		microcontroller (ARM Cortex-M3).  This port uses the GNU Cortex-M3
		toolchain.


config ARCH_BOARD_STM32F3_DISCOVERY
	bool "STMicro STM32F3-Discovery board"
	depends on ARCH_CHIP_STM32F303VC
	select ARCH_HAVE_LEDS
	select ARCH_HAVE_BUTTONS
	select ARCH_HAVE_IRQBUTTONS
	---help---
		STMicro STM32F3-Discovery board based on the STMicro STM32F303VCT6 MCU.

config ARCH_BOARD_STM32F4_DISCOVERY
	bool "STMicro STM32F4-Discovery board"
	depends on ARCH_CHIP_STM32F407VG
	select ARCH_HAVE_LEDS
	select ARCH_HAVE_BUTTONS
	select ARCH_HAVE_IRQBUTTONS
	---help---
		STMicro STM32F4-Discovery board based on the STMicro STM32F407VGT6 MCU.

config ARCH_BOARD_PX4FMU
	bool "PX4FMU board"
	depends on ARCH_CHIP_STM32F405RG
	---help---
		PX4 system Flight Management Unit

config ARCH_BOARD_PX4IO
	bool "PX4IO board"
	depends on ARCH_CHIP_STM32F100C8
	---help---
		PX4 system I/O expansion board

config ARCH_BOARD_TMRFC
	bool "TMRFC board"
	depends on ARCH_CHIP_STM32F405RG
	---help---
		TMR Flight Control Board

config ARCH_BOARD_CUSTOM
	bool "Custom development board"
	---help---
		Select this option if there is no directory for the board under configs/.

		Don't see the board you want?  You must first select the exact MCU part
		number, then the boards supporting that part will be available for selection.		

endchoice

config ARCH_BOARD
	string
	default "nutiny-nuc120"       if ARCH_BOARD_NUTINY_NUC120
	default "stm3210e-eval"       if ARCH_BOARD_STM3210E_EVAL
	default "stm32f3discovery"    if ARCH_BOARD_STM32F3_DISCOVERY
	default "stm32f4discovery"    if ARCH_BOARD_STM32F4_DISCOVERY
	default "px4fmu"              if ARCH_BOARD_PX4FMU
	default "px4io"               if ARCH_BOARD_PX4IO
	default "TMRFC"               if ARCH_BOARD_TMRFC
	default ""                    if ARCH_BOARD_CUSTOM

comment "Common Board Options"

config ARCH_HAVE_LEDS
	bool

config ARCH_LEDS
	bool "Board LED support"
	default y
	depends on ARCH_HAVE_LEDS
	---help---
		Use board LEDs to show NuttX execution status state. Unique to boards that have LEDs

config ARCH_HAVE_BUTTONS
	bool

config ARCH_BUTTONS
	bool "Board button support"
	default n
	depends on ARCH_HAVE_BUTTONS
	---help---
		"Support interfaces to use buttons provided by the board."

config ARCH_HAVE_IRQBUTTONS
	bool

config ARCH_IRQBUTTONS
	bool "Button interrupt support"
	default n
	depends on ARCH_BUTTONS && ARCH_HAVE_IRQBUTTONS
	---help---
		"Support interrupts on button presses and releases."

config NSH_MMCSDMINOR
	int "MMC/SD minor number"
	default 0
	depends on NSH_LIBRARY && MMCSD
	---help---
		If board-specific NSH start-up logic needs to mount an MMC/SD device, then the setting should be provided to identify the MMC/SD minor device number (i.e., the N in /dev/mmcsdN).  Default 0

config NSH_MMCSDSLOTNO
	int "MMC/SD slot number"
	default 0
	depends on NSH_LIBRARY && MMCSD
	---help---
		If board-specific NSH start-up supports more than one MMC/SD slot, then this setting should be provided to indicate which slot should be used.  Default: 0.

config NSH_MMCSDSPIPORTNO
	int "MMC/SD SPI device number"
	default 0
	depends on NSH_LIBRARY && MMCSD && MMCSD_SPI
	---help---
		If board-specif NSH start-up logic will mount an SPI-based MMC/SD volume, then this setting may be needed to tell the board logic which SPI bus to use.  Default: 0 (meaning is board-specific).



comment "Board-Specific Options"

if ARCH_BOARD_NUTINY_NUC120
source "configs/nutiny-nuc120/Kconfig"
endif
if ARCH_BOARD_STM32F3_DISCOVERY
source "configs/stm32f3discovery/Kconfig"
endif
if ARCH_BOARD_STM3210E_EVAL
source "configs/stm3210e-eval/Kconfig"
endif
if ARCH_BOARD_STM32F4_DISCOVERY
source "configs/stm32f4discovery/Kconfig"
endif
if ARCH_BOARD_PX4FMU
source "configs/px4fmu/Kconfig"
endif
if ARCH_BOARD_PX4IO
source "configs/px4io/Kconfig"
endif
if ARCH_BOARD_TMRFC
source "configs/tmrfc/Kconfig"
endif
```
